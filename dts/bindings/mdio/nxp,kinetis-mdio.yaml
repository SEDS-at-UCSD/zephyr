## dts/bindings/mdio/nxp,kinetis-mdio.yaml
```yaml
# Copyright (c) 2021 Bernhard Kraemer
# SPDX-License-Identifier: Apache-2.0

description: NXP Kinetis Family MDIO Driver node

compatible: "nxp,kinetis-mdio"

include: [mdio-controller.yaml, pinctrl-device.yaml]

properties:
  reg:
    required: false
```
